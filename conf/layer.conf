## conf/layer.conf
```bitbake
# We have a conf and classes directory, add to BBPATH
BBPATH .= ":${LAYERDIR}"

# We have recipes-* directories, add to BBFILES
BBFILES += "${LAYERDIR}/recipes-*/*/*.bb \
            ${LAYERDIR}/recipes-*/*/*.bbappend"

BBFILE_COLLECTIONS += "meta-ensemble-tech"
BBFILE_PATTERN_meta-ensemble-tech = "^${LAYERDIR}/"
BBFILE_PRIORITY_meta-ensemble-tech = "6"

LAYERDEPENDS_meta-ensemble-tech = "core"
LAYERSERIES_COMPAT_meta-ensemble-tech = "gatesgarth"
```
